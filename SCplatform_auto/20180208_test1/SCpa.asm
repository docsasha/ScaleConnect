;Основной блок программы автоматической отправки данных о взвешиваниях
;информация об МК и конфигурационные биты
	include <MCSetup.inc>
;настройка выводов дисплея
	include <TM1621Setup.inc>
;коды дисплея
	include <TM1621.inc>
;объявляем переменные для главного модуля
	udata
;переменные для захвата данных с дисплея
LCD_bufer 	res .18 ;адрес ячейки начиная с которой располагается буфер
bufer_count	res .1 ;счетчик общего количества принятых бит (должен распологаться сразу после буфера)
bit_buffer	res .1 ;счетчик бит при захвате с дисплея
byte_buffer	res .1 ;счетчик байт при захвате с дисплея
;-----------------------------------------
	extern pause_05s ;<pauses_20MHz.asm>
	extern init_LCD, LCD_Data_Duplicate ;<TM1621LCD.asm>

;подключаем внешние программные модули

;макросы

;пишем начальные значения ППЗУ

	org 0x0000
	goto start
	org 0x0004 ;вектор прерываний
;-----------------------------------------------------------------------
	bcf INTCON,7 ;запрещаем прерывания
;Захват данных с дисплея весов
	include <TM1621Capture.inc> ;захват даныых с дисплея
	include <TM1621ClrBuf.inc>  ;очистка указателей на буфер дисплея
;-----------------------------------------------------------------------	
start
	lcall initMC;<initMC.inc> Инициализация микроконтроллера
	lcall init_LCD;<TM1621LCD.asm> инициализация дисплея	
	lcall pause_05s ;<pauses_20MHz.asm>пауза
	lcall clr_bufer ;<TM1621ClrBuf.inc> очистка указателей на буфер дисплея
	bsf INTCON,7
	goto $
	
;Распознавание пришедших данных

;Определяем превышен ли минимальный вес реакции

;Если превышен засекаем установленное в настройках время

;Если время прошло, а данные не поменялись - отправляем их на сервер

;Если отправка не удалась - сохраняем данные во внутренней памяти

;Инициализация микроконтроллера
	include <initMC.inc>
	goto $
	end