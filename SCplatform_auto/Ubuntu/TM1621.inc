;-----таблица соответсвия символов чтобы легко было менять для других индикаторов------------
simb0 equ 0x7D ;код символа "0"
simb1 equ 0x60 ;код символа "1" 
simb2 equ 0x3E ;код символа "2"
simb3 equ 0x7A ;код символа "3"
simb4 equ 0x63 ;код символа "4"
simb5 equ 0x5B ;код символа "5","S"
simb6 equ 0x5F ;код символа "6"
simb7 equ 0x70 ;код символа "7"
simb8 equ 0x7F ;код символа "8"
simb9 equ 0x7B ;код символа "9"
simb0_ equ 0xFD ;код символа ".0"
simb1_ equ 0xE0 ;код символа ".1"
simb2_ equ 0xBE ;код символа ".2"
simb3_ equ 0xFA ;код символа ".3"
simb4_ equ 0xE3 ;код символа ".4"
simb5_ equ 0xDB ;код символа ".5"
simb6_ equ 0xDF ;код символа ".6"
simb7_ equ 0xF0 ;код символа ".7"
simb8_ equ 0xFF ;код символа ".8"
simb9_ equ 0xFB ;код символа ".9"
simbA equ 0x77 ;код символа "A"
simbb equ 0x4F ;код символа "b"
simbC equ 0x1D ;код символа "C"
simbd equ 0x6E ;код символа "d"
simbE equ 0x1F ;код символа "E"
simbF equ 0x17 ;код символа "F"
simbG equ 0x5D ;код символа "G"
simbH equ 0x67 ;код символа "H"
simbJ equ 0x6C ;код символа "J"
simbL equ 0x0D ;код символа "L"
simbn equ 0x46 ;код символа "n"
simbP equ 0x37 ;код символа "P"
simbr equ 0x06 ;код символа "r"
simbt equ 0x0F ;код символа "t"
simbU equ 0x6D ;код символа "U"
simbY equ 0x6B ;код символа "Y"
simbmin equ 0x02 ;код символа "минус"
empty equ 0x00 ;код символа "пусто"