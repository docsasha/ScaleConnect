	title "Блок для работы UART"
	list p=16f887
	include <p16f887.inc>

	global TX_LEN, UART_Buf, UART_TX_ON, UART_TX_OFF
	global UART_Setup, SendBytetoUART, SendPackettoUART, GetUARTByte

	udata
TX_LEN res .1
UART_Buf res .8 ;буфер приемо-передатчика
	udata_ovr
TX_temp res .1
RX_temp res .1

;макросы
;------------------------------------------------------------------

	code
;----------------------------------------------------------------
;- Настройка приемо-передатчика
;UART_Setup
UART_Setup
	banksel SPBRG
	movlw .129
	movwf SPBRG ;устанавливаем скорость 9600 бод
	;другие значения SPBRG при тактовой частоте 20МГц:
	; .129 - 9600; .64 - 19200; .32 - 38400; .21 - 57600; .10 - 115200 
	movlw b'00100100'
	movwf TXSTA ;включаем асинхронный режим, высокую скорость передачи
	;TXSTA бит 7 (CSRC) в ассинхронном режиме не имеет значения
	;бит 6 (ТХ9) =0 - 8ми битная передача
	;бит 5 (TXEN) =1 - передача разрешена
	;бит 4 (SYNC) =0 - асинхронный режим работы 
	;бит 3 - не используется, читается как 0
	;бит 2 (BRGH) =1 высокоскоростной режим
	;бит 1 (TRMT) =0 пустой TSR флаг очистки сдвигового регистра передатчика
	;бит 0 (TX9D) 9й бит передаваемых данных для соответствующего режима
;	bsf PIE1, 5 ;разрешить прерывания от приемника 
	banksel PIR1
	bcf PIR1,5
	bcf PIR1,4 ;сбрасываем флаги прерываний от приемопередатчика
	movlw b'00010000'
	movwf RCSTA ;асинхронный режим, прием разрешен
	;RCSTA бит 7 (SPEN) =1 модуль последовательного порта временно выключен
	;бит 6 (RХ9) =0 - 8ми битный прием
	;бит 5 (SREN) =0 - в асинхронном режиме не имеет значения
	;бит 4 (CREN) =1 - прием разрешен
	;бит 3 (ADDEN) =0 в асинхронном 8ми битном режиме не имеет значения
	;бит 2 (FERR) =0 ошибки кадра не было
	;бит 1 (OERR) =0 ошибки переполнения не было
	;бит 0 (RX9D) =0 9й бит принимаемых данных для соответствующего режима
	return
;------------------------------------------------------------------
;- Установка скорости UART
;SetUARTSpeed(UARTSpeed)
;------------------------------------------------------------------
;- Отправить байт по UART
;SendBytetoUART(UARTbyte) отправляемый байт в аккумуляторе
SendBytetoUART 
	banksel TXREG
    movwf  TXREG
    banksel TXSTA
per btfss  TXSTA,1   ; если 1-й бит регистра TXSTA = 1,
                       ; то передача завершена (TSR пуст)
    goto   per
	return
;------------------------------------------------------------------
;- Отправить пакет (до 8) байт (сохраненных в памяти начиная с указанного адреса) по UART
;SendPackettoUART(UART_Buf,TX_LEN)
SendPackettoUART
;отправить в порт до 8 байт хранящиеся в памяти c адреса UART_Buf 
;в TX_LEN - количество байт для отправки в порт
;	call UART_TX_ON;включаем передатчик
	movf FSR,0
	banksel TX_temp
	movwf TX_temp ;сохраняем предыдущее значение регистра косвенной адресации

	movlw UART_Buf
	bankisel UART_Buf 
	movwf FSR
trans32	
	movf INDF,0
	call SendBytetoUART 
	bankisel UART_Buf 
	incf FSR,1
	banksel TX_LEN
	decfsz TX_LEN,1
	goto trans32

	banksel TX_temp
	movf TX_temp,0
	movwf FSR ;восстанавливааем изначальное значение регитсра косвенной адресации
;	call UART_TX_OFF;выключаем передатчик
	return	
;------------------------------------------------------------------
;- Поместить считанный из UART байт в регистр адрес которого указан в аккумуляторе
;GetUARTByte(ADDR)
GetUARTByte

	return	
;------------------------------------------------------------------
UART_TX_ON;включаем передатчик
	banksel TXSTA
	bsf TXSTA,5	;включаем передатчик
	banksel RCSTA	  	
	bsf RCSTA,7
	return
;-----------------------------------------------------------------------
UART_TX_OFF;выключаем передатчик
	banksel TXSTA
	bcf TXSTA,5	;выключаем передатчик
	banksel RCSTA	 
	bcf RCSTA,7
	return
;-----------------------------------------------------------------------
	end