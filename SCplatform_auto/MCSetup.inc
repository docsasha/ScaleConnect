;настройка микроконтроллера - выбор типа и конфигурации
	list p=16f887
	include <p16f887.inc>
	errorlevel	-302
_config1 equ 0X2007
_config2 equ 0X2008

	__config _config1,  b'1110000010100010'
;бит15,14=1 не используются - читаются как 1;
;бит13=1 режим наплатной отладки отключен
;бит12=0 режим низковольтного программирования отключен
;бит11=0 Fail-Safe Clock Monitor is disabled
;бит10=0 Internal/External Switchover mode is disabled
;бит9,8=00 Brown-out Reset disabled 
;бит7=1 защита ППЗУ отключена
;бит6=0 защита памяти программ включена
;бит5=1 вывод RE3/MCLR это MCLR
;бит4=0 PWRT (таймер включения питания) включен
;бит3=0 WDT (сторожевой таймер) отключен
;бит2,1,0=010 HS тактовый генератор

	__config _config2, 	b'1111100011111111'
;бит10,9=0 включение защиты
;бит8=0 сброс по снижению напряжения до 2,1В
	;генератор HS на 20МГц, нет защиты данных